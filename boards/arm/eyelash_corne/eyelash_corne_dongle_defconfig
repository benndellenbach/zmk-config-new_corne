## boards/arm/eyelash_corne/eyelash_corne_dongle_defconfig
```kconfig
CONFIG_ZMK=y

# ----------------------------------------
# Split central (dongle)
# ----------------------------------------
CONFIG_ZMK_SPLIT=y
CONFIG_ZMK_SPLIT_ROLE_CENTRAL=y

# ----------------------------------------
# Bluetooth
# ----------------------------------------
CONFIG_ZMK_BLE=y
CONFIG_BT=y
CONFIG_BT_CENTRAL=y
CONFIG_BT_PERIPHERAL=n

# ----------------------------------------
# USB HID (recommended)
# ----------------------------------------
CONFIG_ZMK_USB=y

# ----------------------------------------
# Identity
# ----------------------------------------
CONFIG_ZMK_KEYBOARD_NAME="Eyelash Corne"

# ----------------------------------------
# Power management
# ----------------------------------------
CONFIG_ZMK_SLEEP=y
CONFIG_ZMK_IDLE_SLEEP_TIMEOUT=600000
```
