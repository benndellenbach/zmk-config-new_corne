/dts-v1/;

/* SoC */
#include <nordic/nrf52840_qiaa.dtsi>

/* Shared keyboard definitions (no SoC) */
#include "eyelash_corne.dtsi"

/ {
    model = "Eyelash Corne Dongle";
    compatible = "eyelash,corne-dongle";

    zmk_split_central: split_central {
        compatible = "zmk,split-central";
    };

    chosen {
        zmk,central = &zmk_split_central;
    };
};

/* 🔑 Dongle has no matrix */
&default_transform {
    status = "disabled";
};
